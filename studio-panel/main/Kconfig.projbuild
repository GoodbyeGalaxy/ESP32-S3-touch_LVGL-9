## studio-panel/main/Kconfig.projbuild
```kconfig
menu "Studio Panel WiFi"

    config ESP_WIFI_SSID
        string "WiFi SSID"
        default ""
        help
            SSID of the WiFi network to connect to.

    config ESP_WIFI_PASSWORD
        string "WiFi Password"
        default ""
        help
            Password for the WiFi network.

    config ESP_WIFI_AUTH_WPA2_PSK
        bool "Require WPA2-PSK"
        default y
        help
            Reject open or WEP networks; require at least WPA2-PSK.

endmenu

menu "Studio Panel WebSocket"

    config WS_HOST
        string "WebSocket server host"
        default "192.168.1.100"
        help
            IP or hostname of the Mac helper running the Studio One WebSocket server.

    config WS_PORT
        int "WebSocket server port"
        default 4211
        help
            TCP port for the WebSocket server (/studio-one endpoint).

endmenu
```
